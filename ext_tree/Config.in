## ext_tree/Config.in
```kconfig
menu "Custom packages"
	source "../ext_tree/package/naa/Config.in"
	source "../ext_tree/package/scream/Config.in"
	source "../ext_tree/package/apscream/Config.in"
	source "../ext_tree/package/aprenderer/Config.in"
	source "../ext_tree/package/status-monitor/Config.in"
	source "../ext_tree/package/uac2_router/Config.in"
	source "../ext_tree/package/buffer_daemon/Config.in"
	source "../ext_tree/package/dlna_bridge/Config.in"
	source "../ext_tree/package/snd-screamalsa/Config.in"
	source "../ext_tree/package/linux510/Config.in"
	source "../ext_tree/package/linux510-pf16/Config.in"
	source "../ext_tree/package/ymusic/Config.in"
endmenu
```

## ext_tree/package/apscream/Config.in
```kconfig
config BR2_PACKAGE_APSCREAM
	bool "apscream"
	help
	  APScream, the Album Player Scream receiver (closed source,
	  ARM32 binary). Receives the ASIO Scream driver for Windows
	  over UDP or TCP unicast, with native DSD in AP mode.

	  https://albumplayer.ru/english.html
```

## ext_tree/package/celmusper-i2s-shim/Config.in
```kconfig
config BR2_PACKAGE_CELMUSPER_I2S_SHIM
	bool "celmusper-i2s-shim"
	depends on BR2_PACKAGE_ALSA_LIB
	help
	  LD_PRELOAD compatibility shim for CelMusper Transport.

	  It presents the Rockchip I2S card as a stereo USB-audio DAC to
	  CelMusper's USB-only enumerator, then redirects its hw:0,0 PCM
	  open to the ALSA default route. The route expands stereo into the
	  board's four I2S slots.
```

## ext_tree/package/doh-proxy/Config.in
```kconfig
config BR2_PACKAGE_DOH_PROXY
	bool "doh-proxy"
	depends on BR2_PACKAGE_LIBCURL
	help
	  Minimal DNS-over-HTTPS proxy. Listens on UDP 127.0.0.1:53
	  and forwards queries to Cloudflare DoH (1.1.1.1).
```

## ext_tree/package/linux510-pf16/Config.in
```kconfig
config BR2_PACKAGE_LINUX510_PF16
	bool "linux510-pf16"
	depends on BR2_PACKAGE_LINUX510
	help
	  Third kernel choice: Linux 5.10 with the I2S driver and
	  device trees of PureFox 1.6. Installed to /data/boot/1.6
	  and selected on the device with /opt/kernel.sh 1.6.
```

## ext_tree/package/linux510/Config.in
```kconfig
config BR2_PACKAGE_LINUX510
	bool "linux510"
	depends on BR2_LINUX_KERNEL
	help
	  Second kernel (Rockchip BSP Linux 5.10, as in PureFox 1.x)
	  with the PureFox I2S driver. Installed to /data/boot/5.10
	  and selected on the device with /opt/kernel.sh.
```

## ext_tree/package/nfqws2/Config.in
```kconfig
config BR2_PACKAGE_NFQWS2
	bool "nfqws2"
	depends on BR2_PACKAGE_IPTABLES
	select BR2_PACKAGE_LIBNETFILTER_QUEUE
	help
	  nfqws2 — DPI bypass utility (NFQUEUE-based TCP/UDP packet modification).
	  Includes nfqws2 binary from zapret2, Lua strategies, and init scripts.
	  https://github.com/nfqws/nfqws2-keenetic
```

## ext_tree/package/rinetd/Config.in
```kconfig
config BR2_PACKAGE_RINETD
	bool "rinetd"
	help
	  TCP port forwarder. Listens on local port, forwards to remote.
```

## ext_tree/package/scream/Config.in
```kconfig
config BR2_PACKAGE_SCREAM
	bool "scream"
	depends on BR2_PACKAGE_ALSA_LIB
	help
	  Scream network audio receiver (Unix receiver, ALSA output).
	  Plays audio sent by the Scream virtual sound card driver
	  for Windows over UDP multicast or unicast.

	  https://github.com/duncanthrax/scream
```

## ext_tree/package/volume-encoder/Config.in
```kconfig
config BR2_PACKAGE_VOLUME_ENCODER
	bool "volume-encoder"
	help
	  Maps the PureFox rotary encoder input to the I2S ALSA volume control.
```

## ext_tree/package/ymusic/Config.in
```kconfig
config BR2_PACKAGE_YMUSIC
	bool "ymusic"
	depends on BR2_TOOLCHAIN_HAS_THREADS
	select BR2_PACKAGE_LIBCURL
	select BR2_PACKAGE_OPENSSL
	select BR2_PACKAGE_CA_CERTIFICATES
	select BR2_PACKAGE_ALSA_LIB
	select BR2_PACKAGE_FLAC
	select BR2_PACKAGE_LIBMAD
	select BR2_PACKAGE_LIBSOXR
	help
	  Yandex Music (ported from DigiFox). ymusicd on port 6601 serves a
	  JSON API for a desktop app (login, browse, search, queue, My Wave,
	  playback control) and plays the queue itself: decrypts the track
	  files (encraw, AES-128-CTR), decodes FLAC (libFLAC) and MP3
	  (libmad) and writes them to ALSA unchanged. With RESAMPLE_48=1 in
	  /etc/i2s.conf (no 48 kHz oscillator on the board) tracks of the
	  48 kHz family go through libsoxr to the same multiple of 44.1 kHz;
	  44.1 kHz tracks still go to ALSA unchanged.
```
